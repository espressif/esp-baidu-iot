## examples/iot_smarthome_client_sample/sdkconfig.defaults
```kconfig
# for ESP32
CONFIG_MBEDTLS_SSL_MAX_CONTENT_LEN=6144

# for ESP8266
CONFIG_SSL_USING_MBEDTLS=y
CONFIG_MBEDTLS_SSL_OUT_CONTENT_LEN=6144
CONFIG_MBEDTLS_SSL_IN_CONTENT_LEN=6144

CONFIG_NEWLIB_ENABLE=y
CONFIG_NEWLIB_LIBRARY_LEVEL_NORMAL=y

#CONFIG_MBEDTLS_DEBUG=y
#CONFIG_MBEDTLS_DEBUG_LEVEL=4

# for ESP32 watch dog interval
CONFIG_TASK_WDT_TIMEOUT_S=60
```
